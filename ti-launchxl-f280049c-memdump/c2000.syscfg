/**
 * @cliArgs --board "/boards/LAUNCHXL_F280049C" --device "F28004x" --part "F28004x_100PZ" --package "F28004x_100PZ" --context "system" --product "C2000WARE@26.01.00.00"
 * @versions {"tool":"1.27.1+4634"}
 */

/**
 * Import the modules used in this configuration.
 */
const cputimer  = scripting.addModule("/driverlib/cputimer.js", {}, false);
const cputimer1 = cputimer.addInstance();
const sci       = scripting.addModule("/driverlib/sci.js", {}, false);
const sci1      = sci.addInstance();

/**
 * Write custom configuration values to the imported modules.
 */
cputimer1.$name          = "CPUTIMER_TimeBase";
cputimer1.timerPrescaler = 9;
cputimer1.timerPeriod    = 4294967295;

sci1.$name        = "XDS_SCIA";
sci1.$hardware    = system.deviceData.board.components.XDS_UART.subComponents.XDS_SCI_INST1;
sci1.rxQual.$name = "myGPIOQUAL0";
sci1.txQual.$name = "myGPIOQUAL1";

/**
 * Pinmux solution for unlocked pins/peripherals. This ensures that minor changes to the automatic solver in a future
 * version of the tool will not impact the pinmux you originally saw.  These lines can be completely deleted in order to
 * re-solve from scratch.
 */
sci1.sci.$suggestSolution           = "SCIA";
sci1.sci.sci_rxPin.$suggestSolution = "boosterpack2.43";
sci1.sci.sci_txPin.$suggestSolution = "boosterpack2.44";
